
; ANSI-C/cC++ Compiler for HC08 V-5.0.15, Apr 11 2002
;
; Automatic generated include file for the assembler
; Generated using the following files :
; file :'Z:\vph1\Code\buffer.cpp'
; file :'E:\Documents and settings\oscar\Mis documentos\bin\Metrowerks\CodeWarrior HC08_V2.0\lib\HC08c\INCLUDE\math.h'
; file :'E:\Documents and settings\oscar\Mis documentos\bin\Metrowerks\CodeWarrior HC08_V2.0\lib\HC08c\INCLUDE\ieeemath.h'
; file :'E:\Documents and settings\oscar\Mis documentos\bin\Metrowerks\CodeWarrior HC08_V2.0\lib\HC08c\INCLUDE\stdlib.h'
; file :'E:\Documents and settings\oscar\Mis documentos\bin\Metrowerks\CodeWarrior HC08_V2.0\lib\HC08c\INCLUDE\stddef.h'
; file :'E:\Documents and settings\oscar\Mis documentos\bin\Metrowerks\CodeWarrior HC08_V2.0\lib\HC08c\INCLUDE\libdefs.h'
; file :'E:\Documents and settings\oscar\Mis documentos\bin\Metrowerks\CodeWarrior HC08_V2.0\lib\HC08c\INCLUDE\hidef.h'
; file :'E:\Documents and settings\oscar\Mis documentos\bin\Metrowerks\CodeWarrior HC08_V2.0\lib\HC08c\INCLUDE\stddef.h'
; file :'E:\Documents and settings\oscar\Mis documentos\bin\Metrowerks\CodeWarrior HC08_V2.0\lib\HC08c\INCLUDE\stdtypes.h'
; file :'Z:\vph1\Code\buffer.h'
;
