/*
** ###################################################################
**
**     THIS BEAN MODULE IS GENERATED BY THE TOOL. DO NOT MODIFY IT.
**
**     Filename  : LEDS.C
**
**     Project   : vph1
** 
**     Processor : MC68HC908GP32CFB
**
**     Beantype  : ByteIO
**
**     Version   : Bean 02.018, Driver 02.15, CPU db: 2.89.000
**
**     Compiler  : Metrowerks HC08 C Compiler
**
**     Date/Time : 4/30/viernes, 11:09
**
**     Abstract  :
**
**         This bean "ByteIO" implements an one-byte input/output.
**         It uses one 8-bit port.
**         Note: This bean is set to work in Output direction only.
**         Methods of this bean are mostly implemented as a macros 
**         (if supported by target langauage and compiler).
**
**     Settings  :
**
**         Port name                   : PTB
**
**         Initial direction           : Output (direction cannot be changed)
**         Initial output value        : 0 = 000H
**         Initial pull option         : off
**
**         8-bit data register         : PTB       [1]
**         8-bit control register      : DDRB      [5]
**
**             ----------------------------------------------------
**                   Bit     |   Pin   |   Name
**             ----------------------------------------------------
**                    0      |    22   |   PTB0_AD0
**                    1      |    23   |   PTB1_AD1
**                    2      |    24   |   PTB2_AD2
**                    3      |    25   |   PTB3_AD3
**                    4      |    26   |   PTB4_AD4
**                    5      |    27   |   PTB5_AD5
**                    6      |    28   |   PTB6_AD6
**                    7      |    29   |   PTB7_AD7
**             ----------------------------------------------------
**
**     Contents  :
**
**         GetDir - bool LEDS_GetDir(void);
**         GetVal - byte LEDS_GetVal(void);
**         PutVal - void LEDS_PutVal(byte Val);
**         GetBit - bool LEDS_GetBit(byte Bit);
**         PutBit - void LEDS_PutBit(byte Bit,bool Val);
**         SetBit - void LEDS_SetBit(byte Bit);
**         ClrBit - void LEDS_ClrBit(byte Bit);
**         NegBit - void LEDS_NegBit(byte Bit);
**
**
**     (c) Copyright UNIS, spol. s r.o. 1997-2002
**
**     UNIS, spol. s r.o.
**     Jundrovska 33
**     624 00 Brno
**     Czech Republic
**
**     http      : www.processorexpert.com
**     mail      : info@processorexpert.com
**
** ###################################################################
*/

#include "LEDS.h"

/*Including shared modules, which are used for all project*/
#include "PE_Types.h"
#include "PE_Error.h"
#include "PE_Const.h"
#include "IO_Map.h"
#include "Cpu.h"

/*
** ===================================================================
**     Method      :  LEDS_GetMsk (bean ByteIO)
**
**     Description :
**         This method is internal. It is used by Processor Expert
**         only.
** ===================================================================
*/
const byte LEDS_Table[8]={ 1, 2, 4, 8, 16, 32, 64, 128 }; /* Table of mask constants */

byte LEDS_GetMsk(byte Value)
{
  return((Value<8)?LEDS_Table[Value]:0); /* Return appropriate bit mask */
}

/*
** ===================================================================
**     Method      :  LEDS_GetVal (bean ByteIO)
**
**     Description :
**         This method returns an input value.
**           a) direction = Input  : reads the input value from the
**                                   pins and returns it
**           b) direction = Output : returns the last written value
**         Note: This bean is set to work in Output direction only.
**     Parameters  : None
**     Returns     :
**         ---        - Input value (0 to 255)
** ===================================================================
*/
/*
byte LEDS_GetVal(void)

**  This method is implemented as a macro. See LEDS.h file.  **
*/

/*
** ===================================================================
**     Method      :  LEDS_PutVal (bean ByteIO)
**
**     Description :
**         This method writes the new output value.
**     Parameters  :
**         NAME       - DESCRIPTION
**         Value      - Output value (0 to 255)
**     Returns     : Nothing
** ===================================================================
*/
/*
void LEDS_PutVal(byte Value)

**  This method is implemented as a macro. See LEDS.h file.  **
*/

/*
** ===================================================================
**     Method      :  LEDS_GetBit (bean ByteIO)
**
**     Description :
**         This method returns the specified bit of the input value.
**           a) direction = Input  : reads the input value from pins
**                                   and returns the specified bit
**           b) direction = Output : returns the specified bit
**                                   of the last written value
**         Note: This bean is set to work in Output direction only.
**     Parameters  :
**         NAME       - DESCRIPTION
**         Bitnum     - Number of the bit to read (0 to 7)
**     Returns     :
**         ---        - Value of the specified bit (FALSE or TRUE)
**                      FALSE = "0" or "Low", TRUE = "1" or "High"
** ===================================================================
*/
bool LEDS_GetBit(byte BitNum)
{
  byte Mask=LEDS_GetMsk(BitNum);       /* Temporary variable - bit mask */
  byte Val;                            /* Temporary variable */
  byte Result=0;                       /* Temporary variable */

  if (Mask) {                          /* Is bit mask correct? */
    Val = PTB;                         /* Load of actual value of the port */
    Val &= Mask;                       /* Mask appropriate bit */
    Result = (Val == Mask);            /* If value of masked bit is non-zero then store logical one to the variable Result */
  }
  return(Result);                      /* Return input value */
}

/*
** ===================================================================
**     Method      :  LEDS_PutBit (bean ByteIO)
**
**     Description :
**         This method writes the new value to the specified bit
**         of the output value.
**     Parameters  :
**         NAME       - DESCRIPTION
**         Bitnum     - Number of the bit (0 to 7)
**         Val        - New value of the bit (FALSE or TRUE)
**                      FALSE = "0" or "Low", TRUE = "1" or "High"
**     Returns     : Nothing
** ===================================================================
*/
void LEDS_PutBit(byte BitNum, byte Value)
{
  byte Mask=LEDS_GetMsk(BitNum);       /* Temporary variable - bit mask */

  if (Mask)                            /* Is bit mask correct? */
    if (Value) {                       /* Is it one to be written? */
      PTB |= Mask;                     /* Set appropriate bit on port */
    }
    else {                             /* Is it zero to be written? */
      PTB &= ~Mask;                    /* Clear appropriate bit on port */
    }
}

/*
** ===================================================================
**     Method      :  LEDS_SetBit (bean ByteIO)
**
**     Description :
**         This method sets (sets to one) the specified bit of the
**         output value.
**         [ It is the same as "PutBit(Bit,TRUE);" ]
**     Parameters  :
**         NAME       - DESCRIPTION
**         Bitnum     - Number of the bit to set (0 to 7)
**     Returns     : Nothing
** ===================================================================
*/
void LEDS_SetBit(byte BitNum)
{
  byte Mask=LEDS_GetMsk(BitNum);       /* Temporary variable - bit mask */

  if (Mask) {                          /* Is bit mask correct? */
    PTB |= Mask;                       /* Set appropriate bit on port */
  }
}

/*
** ===================================================================
**     Method      :  LEDS_ClrBit (bean ByteIO)
**
**     Description :
**         This method clears (sets to zero) the specified bit
**         of the output value.
**         [ It is the same as "PutBit(Bit,FALSE);" ]
**     Parameters  :
**         NAME       - DESCRIPTION
**         BitNum     - Number of the bit to clear (0 to 7)
**     Returns     : Nothing
** ===================================================================
*/
void LEDS_ClrBit(byte BitNum)
{
  byte Mask=LEDS_GetMsk(BitNum);       /* Temporary variable - bit mask */

  if (Mask) {                          /* Is bit mask correct? */
    PTB &= ~Mask;                      /* Clear appropriate bit on port */
  }
}

/*
** ===================================================================
**     Method      :  LEDS_NegBit (bean ByteIO)
**
**     Description :
**         This method negates (invertes) the specified bit of the
**         output value.
**     Parameters  :
**         NAME       - DESCRIPTION
**         Bit        - Number of the bit to invert (0 to 7)
**     Returns     : Nothing
** ===================================================================
*/
void LEDS_NegBit(byte BitNum)
{
  byte Mask=LEDS_GetMsk(BitNum);       /* Temporary variable - bit mask */

  if (Mask) {                          /* Is bit mask correct? */
    PTB ^= Mask;                       /* Negate appropriate bit on port */
  }
}

/*
** ===================================================================
**     Method      :  LEDS_GetDir (bean ByteIO)
**
**     Description :
**         This method returns direction of the bean.
**     Parameters  : None
**     Returns     :
**         ---        - Direction of the bean (always TRUE, Output only)
**                      FALSE = Input, TRUE = Output
** ===================================================================
*/
/*
bool LEDS_GetDir(void)

**  This method is implemented as a macro. See LEDS.h file.  **
*/

/*
** ###################################################################
**
**     This file was created by UNIS Processor Expert 03.23 for 
**     the Motorola HC08 series of microcontrollers.
**
** ###################################################################
*/
