/*
** ###################################################################
**
**     THIS BEAN MODULE IS GENERATED BY THE TOOL. DO NOT MODIFY IT.
**
**     Filename  : APERTURA.C
**
**     Project   : vph1
** 
**     Processor : MC68HC908GP32CFB
**
**     Beantype  : BitsIO
**
**     Version   : Bean 02.022, Driver 02.16, CPU db: 2.89.000
**
**     Compiler  : Metrowerks HC08 C Compiler
**
**     Date/Time : 29/03/2006, 11:22
**
**     Abstract  :
**
**         This bean "BitsIO" implements a multi-bit input/output.
**         It uses selected pins of one 1-bit to 8-bit port.
**
**     Settings  :
**
**         Port name                   : PTB
**
**         Bit mask of the port        : 112
**         Number of bits/pins         : 3
**         Single bit numbers          : 0 to 2
**         Values range                : 0 to 7
**
**         Initial direction           : Input (direction can be changed)
**         Safe mode                   : yes
**         Initial output value        : 0 = 000H
**         Initial pull option         : off
**
**         Port data register          : PTB       [1]
**         Port control register       : DDRB      [5]
**
**             ----------------------------------------------------
**                   Bit     |   Pin   |   Name
**             ----------------------------------------------------
**                    0      |    26   |   PTB4_AD4
**                    1      |    27   |   PTB5_AD5
**                    2      |    28   |   PTB6_AD6
**             ----------------------------------------------------
**
**         Optimization for            : speed
**
**     Contents  :
**
**         GetDir - bool APERTURA_GetDir(void);
**         SetDir - void APERTURA_SetDir(bool Dir);
**         GetVal - byte APERTURA_GetVal(void);
**         PutVal - void APERTURA_PutVal(byte Val);
**         GetBit - bool APERTURA_GetBit(byte Bit);
**         PutBit - void APERTURA_PutBit(byte Bit,bool Val);
**         SetBit - void APERTURA_SetBit(byte Bit);
**         ClrBit - void APERTURA_ClrBit(byte Bit);
**         NegBit - void APERTURA_NegBit(byte Bit);
**
**
**     (c) Copyright UNIS, spol. s r.o. 1997-2002
**
**     UNIS, spol. s r.o.
**     Jundrovska 33
**     624 00 Brno
**     Czech Republic
**
**     http      : www.processorexpert.com
**     mail      : info@processorexpert.com
**
** ###################################################################
*/

#include "APERTURA.h"

/*Include shared modules, which are used for whole project*/
#include "PE_Types.h"
#include "PE_Error.h"
#include "PE_Const.h"
#include "IO_Map.h"
#include "Cpu.h"

const byte APERTURA_Table[8]={ 1, 2, 4, 8, 16, 32, 64, 128 }; /* Table of mask constants */
/*
** ===================================================================
**     Method      :  APERTURA_GetMsk (bean BitsIO)
**
**     Description :
**         This method is internal. It is used by Processor Expert
**         only.
** ===================================================================
*/
byte APERTURA_GetMsk(byte Value)
{
  return((Value<3)?APERTURA_Table[Value+4]:0); /* Return appropriate bit mask */
}

/*
** ===================================================================
**     Method      :  APERTURA_GetVal (bean BitsIO)
**
**     Description :
**         This method returns an input value.
**           a) direction = Input  : reads the input value from the
**                                   pins and returns it
**           b) direction = Output : returns the last written value
**     Parameters  : None
**     Returns     :
**         ---        - Input value (0 to 7)
** ===================================================================
*/
/*
byte APERTURA_GetVal(void)

**  This method is implemented as a macro. See APERTURA.h file.  **
*/

/*
** ===================================================================
**     Method      :  APERTURA_PutVal (bean BitsIO)
**
**     Description :
**         This method writes the new output value.
**           a) direction = Input  : sets the new output value;
**                                   this operation will be shown on
**                                   output after the direction has
**                                   been switched to output
**                                   (SetDir(TRUE);)
**           b) direction = Output : directly writes the value to the
**                                   appropriate pins
**     Parameters  :
**         NAME       - DESCRIPTION
**         Value      - Output value (0 to 7)
**     Returns     : Nothing
** ===================================================================
*/
void APERTURA_PutVal(byte Value)
{
  byte Temp;                           /* Temporary variable */

  Temp = (Value<<4) & 112;             /* Prepare value for output */
  Shadow_PTB = Shadow_PTB & ~112 | Temp; /* Set-up bits in shadow variable */
  PTB = PTB & ~112 | Temp;             /* Set-up bits on port */
}

/*
** ===================================================================
**     Method      :  APERTURA_GetBit (bean BitsIO)
**
**     Description :
**         This method returns the specified bit of the input value.
**           a) direction = Input  : reads the input value from pins
**                                   and returns the specified bit
**           b) direction = Output : returns the specified bit
**                                   of the last written value
**     Parameters  :
**         NAME       - DESCRIPTION
**         BitNum     - Number of the bit to read (0 to 2)
**     Returns     :
**         ---        - Value of the specified bit (FALSE or TRUE)
**                      FALSE = "0" or "Low", TRUE = "1" or "High"
** ===================================================================
*/
bool APERTURA_GetBit(byte BitNum)
{
  byte Mask=APERTURA_GetMsk(BitNum);   /* Temporary variable - bit mask */

  return((Mask)?(PTB & Mask) == Mask:0); /* Return input value */
}

/*
** ===================================================================
**     Method      :  APERTURA_PutBit (bean BitsIO)
**
**     Description :
**         This method writes the new value to the specified bit
**         of the output value.
**           a) direction = Input  : sets the value of the specified
**                                   bit; this operation will be
**                                   shown on output after the
**                                   direction has been switched to
**                                   output (SetDir(TRUE);)
**           b) direction = Output : directly writes the value of the
**                                   bit to the appropriate pin
**     Parameters  :
**         NAME       - DESCRIPTION
**         BitNum     - Number of the bit (0 to 2)
**         Value      - New value of the bit (FALSE or TRUE)
**                      FALSE = "0" or "Low", TRUE = "1" or "High"
**     Returns     : Nothing
** ===================================================================
*/
void APERTURA_PutBit(byte BitNum, byte Value)
{
  byte Mask=APERTURA_GetMsk(BitNum);   /* Temporary variable - bit mask */

  if (Mask)  {                         /* Is bit mask correct? */
    if (Value) {                       /* Is it one to be written? */
      Shadow_PTB |= Mask;              /* Set appropriate bit in shadow variable */
      PTB |= Mask;                     /* Set appropriate bit on port */
    }
    else {                             /* Is it zero to be written? */
      Shadow_PTB &= ~Mask;             /* Clear appropriate bit in shadow variable */
      PTB &= ~Mask;                    /* Clear appropriate bit on port */
    }
  }
}

/*
** ===================================================================
**     Method      :  APERTURA_SetBit (bean BitsIO)
**
**     Description :
**         This method sets (sets to one) the specified bit of the
**         output value.
**         [ It is the same as "PutBit(Bit,TRUE);" ]
**           a) direction = Input  : sets the specified bit to "1";
**                                   this operation will be shown on
**                                   output after the direction has
**                                   been switched to output
**                                   (SetDir(TRUE);)
**           b) direction = Output : directly writes "1" to the
**                                   appropriate pin
**     Parameters  :
**         NAME       - DESCRIPTION
**         BitNum     - Number of the bit to set (0 to 2)
**     Returns     : Nothing
** ===================================================================
*/
void APERTURA_SetBit(byte BitNum)
{
  byte Mask=APERTURA_GetMsk(BitNum);   /* Temporary variable - bit mask */

  if (Mask) {                          /* Is bit mask correct? */
    Shadow_PTB |= Mask;                /* Set appropriate bit in shadow variable */
    PTB |= Mask;                       /* Set appropriate bit on port */
  }
}

/*
** ===================================================================
**     Method      :  APERTURA_ClrBit (bean BitsIO)
**
**     Description :
**         This method clears (sets to zero) the specified bit
**         of the output value.
**         [ It is the same as "PutBit(Bit,FALSE);" ]
**           a) direction = Input  : sets the specified bit to "0";
**                                   this operation will be shown on
**                                   output after the direction has
**                                   beenswitched to output
**                                   (SetDir(TRUE);)
**           b) direction = Output : directly writes "0" to the
**                                   appropriate pin
**     Parameters  :
**         NAME       - DESCRIPTION
**         BitNum     - Number of the bit to clear (0 to 2)
**     Returns     : Nothing
** ===================================================================
*/
void APERTURA_ClrBit(byte BitNum)
{
  byte Mask=APERTURA_GetMsk(BitNum);   /* Temporary variable - bit mask */

  if (Mask) {                          /* Is bit mask correct? */
    Shadow_PTB &= ~Mask;               /* Clear appropriate bit in shadow variable */
    PTB &= ~Mask;                      /* Clear appropriate bit on port */
  }
}

/*
** ===================================================================
**     Method      :  APERTURA_NegBit (bean BitsIO)
**
**     Description :
**         This method negates (invertes) the specified bit of the
**         output value.
**           a) direction = Input  : invertes the specified bit;
**                                   this operation will be shown on
**                                   output after the direction has
**                                   been switched to output
**                                   (SetDir(TRUE);)
**           b) direction = Output : directly invertes the value
**                                   of the appropriate pin
**     Parameters  :
**         NAME       - DESCRIPTION
**         BitNum     - Number of the bit to invert (0 to 31)
**     Returns     : Nothing
** ===================================================================
*/
void APERTURA_NegBit(byte BitNum)
{
  byte Mask=APERTURA_GetMsk(BitNum);   /* Temporary variable - bit mask */

  if (Mask) {                          /* Is bit mask correct? */
    Shadow_PTB ^= Mask;                /* Negate appropriate bit in shadow variable */
    PTB ^= Mask;                       /* Negate appropriate bit on port */
  }
}

/*
** ===================================================================
**     Method      :  APERTURA_SetDir (bean BitsIO)
**
**     Description :
**         This method sets direction of the bean.
**     Parameters  :
**         NAME       - DESCRIPTION
**         DirOutput  - Direction to set (FALSE or TRUE)
**                      FALSE = Input, TRUE = Output
**     Returns     : Nothing
** ===================================================================
*/
void APERTURA_SetDir(byte DirOutput)
{
  if (DirOutput) {                     /* Is given direction output? */
    PTB = (PTB & ~112)|(Shadow_PTB & 112); /* Restore correct value of output from shadow variable */
    DDRB |= 112;                       /* Set direction to output */
  }
  else                                 /* Is direction input? */
    DDRB &= ~112;                      /* Set direction to input */
}

/*
** ===================================================================
**     Method      :  APERTURA_GetDir (bean BitsIO)
**
**     Description :
**         This method returns direction of the bean.
**     Parameters  : None
**     Returns     :
**         ---        - Direction of the bean (FALSE or TRUE)
**                      FALSE = Input, TRUE = Output
** ===================================================================
*/
/*
bool APERTURA_GetDir(void)

**  This method is implemented as a macro. See APERTURA.h file.  **
*/

/*
** ###################################################################
**
**     This file was created by UNIS Processor Expert 03.23 for 
**     the Motorola HC08 series of microcontrollers.
**
** ###################################################################
*/
