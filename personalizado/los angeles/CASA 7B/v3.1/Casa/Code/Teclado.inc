
; ANSI-C/cC++ Compiler for HC08 V-5.0.15, Apr 11 2002
;
; Automatic generated include file for the assembler
; Generated using the following files :
; file :'Z:\vph1\Code\Teclado.C'
; file :'Z:\vph1\Code\Teclado.h'
; file :'Z:\vph1\Code\PE_Types.h'
; file :'Z:\vph1\Code\PE_Error.h'
; file :'Z:\vph1\Code\PE_Const.h'
; file :'Z:\vph1\Code\IO_Map.h'
; file :'Z:\vph1\Code\PE_Types.h'
; file :'Z:\vph1\Code\Cpu.h'
; file :'Z:\vph1\Code\PE_Types.h'
; file :'Z:\vph1\Code\PE_Error.h'
; file :'Z:\vph1\Code\PE_Const.h'
; file :'Z:\vph1\Code\IO_Map.h'
; file :'Z:\vph1\Code\PE_Types.h'
; file :'Z:\vph1\Code\PE_Types.h'
; file :'Z:\vph1\Code\PE_Error.h'
; file :'Z:\vph1\Code\PE_Const.h'
; file :'Z:\vph1\Code\IO_Map.h'
; file :'Z:\vph1\Code\PE_Types.h'
; file :'Z:\vph1\Code\Cpu.h'
;
