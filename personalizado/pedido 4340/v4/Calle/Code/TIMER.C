/*
** ###################################################################
**
**     THIS BEAN MODULE IS GENERATED BY THE TOOL. DO NOT MODIFY IT.
**
**     Filename  : TIMER.C
**
**     Project   : vph1
** 
**     Processor : MC68HC908GP32CFB
**
**     Beantype  : TimerInt
**
**     Version   : Bean 02.055, Driver 01.10, CPU db: 2.87.041
**
**     Compiler  : Metrowerks HC08 C Compiler V-5.0.13
**
**     Date/Time : 26/5/05, 9:36
**
**     Abstract  :
**
**         This bean "TimerInt" implements a periodic interrupt.
**         When the bean and its events are enabled, the "OnInterrupt"
**         event is called periodically with the period that you specify.
**         TimerInt supports also changing the period in runtime.
**         The source of periodic interrupt can be timer compare or reload 
**         register or timer-overflow interrupt (of free running counter).
**
**     Settings  :
**
**         Timer name                  : TIM2 (16-bit)
**         Compare name                : TIM21
**         Counter shared              : No
**
**         High-speed CPU mode
**             Prescaler               : divide-by-1
**             Clock                   : 4915200 Hz
**           Initial period/frequency
**             Xtal ticks              : 33
**             microseconds            : 1000
**             milliseconds            : 1
**             seconds (real)          : 0.0010000
**             Hz                      : 1000
**             kHz                     : 1
**
**         Runtime setting             : none
**
**         Initialization:
**              Timer                  : Disabled
**              Events                 : Enabled
**
**         Timer registers
**              Counter                : T2CNT     [44]
**              Mode                   : T2SC      [43]
**              Run                    : T2SC      [43]
**              Prescaler              : T2SC      [43]
**
**         Compare registers
**              Compare                : T2CH1     [52]
**
**         Flip-flop registers
**              Mode                   : T2SC1     [51]
**
**     Contents  :
**
**         Enable  - byte TIMER_Enable(void);
**         Disable - byte TIMER_Disable(void);
**
**
**     (c) Copyright UNIS, spol. s r.o. 1997-2002
**
**     UNIS, spol. s r.o.
**     Jundrovska 33
**     624 00 Brno
**     Czech Republic
**
**     http      : www.processorexpert.com
**     mail      : info@processorexpert.com
**
** ###################################################################
*/


/* MODULE TIMER. */

#include "Events.h"
#include "PE_Error.h"
#include "TIMER.h"

#pragma MESSAGE DISABLE C2705          /* WARNING C2705: Possible loss of data */
#pragma MESSAGE DISABLE C5919          /* WARNING C5919: Conversion of floating to unsigned integral */

static bool EnUser;                    /* Enable/Disable device by user */


/*
** ===================================================================
**     Method      :  TIMER_SetCV (bean TimerInt)
**
**     Description :
**         This method is internal. It is used by Processor Expert
**         only.
** ===================================================================
*/
static void SetCV(word Val)
{
  T2CH1H = (*(TWREG*)&Val).b.high;     /* Store given value to the compare register */
  T2MODH = (*(TWREG*)&Val).b.high;     /* and to the modulo register */
  T2CH1L = (*(TWREG*)&Val).b.low;
  T2MODL = (*(TWREG*)&Val).b.low;
}

/*
** ===================================================================
**     Method      :  TIMER_SetPV (bean TimerInt)
**
**     Description :
**         This method is internal. It is used by Processor Expert
**         only.
** ===================================================================
*/
static void SetPV(byte Val)
{
  T2SC_PS = Val;                       /* Store given value to the prescaler */
  T2SC_TRST = 1;                       /* Reset counter */
}

/*
** ===================================================================
**     Method      :  TIMER_HWEnDi (bean TimerInt)
**
**     Description :
**         This method is internal. It is used by Processor Expert
**         only.
** ===================================================================
*/
static void HWEnDi(void)
{
  if (EnUser) {                        /* Enable device? */
    T2SC_TSTOP = 0;                    /* Run counter */
  }
  else {                               /* Disable device? */
    T2SC_TSTOP = 1;                    /* Stop counter */
    T2SC_TRST = 1;                     /* Reset counter */
  }
}

/*
** ===================================================================
**     Method      :  TIMER_Enable (bean TimerInt)
**
**     Description :
**         Enable the bean - it starts the timer. Events may be
**         generated ("DisableEvent"/"EnableEvent").
**     Parameters  : None
**     Returns     :
**         ---             - Error code, possible codes:
**                           ERR_OK - OK
**                           ERR_SPEED - This device does not work in
**                           the active speed mode
** ===================================================================
*/
byte TIMER_Enable(void)
{
  if (!EnUser) {                       /* Is the device disabled by user? */
    EnUser = TRUE;                     /* If yes then set the flag "device enabled" */
    HWEnDi();                          /* Enable the device */
  }
  return ERR_OK;                       /* OK */
}

/*
** ===================================================================
**     Method      :  TIMER_Disable (bean TimerInt)
**
**     Description :
**         Disable the bean - it stops the timer. No events will be
**         generated.
**     Parameters  : None
**     Returns     :
**         ---             - Error code, possible codes:
**                           ERR_OK - OK
**                           ERR_SPEED - This device does not work in
**                           the active speed mode
** ===================================================================
*/
byte TIMER_Disable(void)
{
  if (EnUser) {                        /* Is the device enabled by user? */
    EnUser = FALSE;                    /* If yes then set the flag "device disabled" */
    HWEnDi();                          /* Disable the device */
  }
  return ERR_OK;                       /* OK */
}

/*
** ===================================================================
**     Method      :  TIMER_Init (bean TimerInt)
**
**     Description :
**         This method is internal. It is used by Processor Expert
**         only.
** ===================================================================
*/
void TIMER_Init(void)
{
  T2SC = 48;                           /* Set up (output) compare mode */
  T2SC1 = 80;
  EnUser = FALSE;                      /* Disable device */
  SetCV(4915);                         /* Store appropriate value to the compare register according to the selected high speed CPU mode */
  SetPV(0);                            /* Set prescaler register according to the selected high speed CPU mode */
  HWEnDi();                            /* Enable/disable device according to status flags */
}

/*
** ===================================================================
**     Method      :  TIMER_Interrupt (bean TimerInt)
**
**     Description :
**         This method is internal. It is used by Processor Expert
**         only.
** ===================================================================
*/
__interrupt void TIMER_Interrupt(void)
{
  T2SC1_CHxF = 0;                      /* Reset interrupt request flag */
  TIMER_OnInterrupt();                 /* Invoke user event */
}


/* END TIMER. */

/*
** ###################################################################
**
**     This file was created by UNIS Processor Expert 02.89 for 
**     the Motorola HC08 series of microcontrollers.
**
** ###################################################################
*/
