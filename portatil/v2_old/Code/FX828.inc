
; ANSI-C/cC++ Compiler for HC08 V-5.0.15, Apr 11 2002
;
; Automatic generated include file for the assembler
; Generated using the following files :
; file :'Z:\vph1\Code\FX828.cpp'
; file :'Z:\vph1\Code\FX828.H'
; file :'Z:\vph1\Code\pe_types.h'
; file :'Z:\vph1\Code\buffer.h'
; file :'Z:\vph1\Code\serie.h'
; file :'Z:\vph1\Code\Serie_chip_select.h'
; file :'Z:\vph1\Code\PE_Types.h'
; file :'Z:\vph1\Code\PE_Error.h'
; file :'Z:\vph1\Code\PE_Const.h'
; file :'Z:\vph1\Code\IO_Map.h'
; file :'Z:\vph1\Code\PE_Types.h'
; file :'Z:\vph1\Code\Cpu.h'
; file :'Z:\vph1\Code\PE_Types.h'
; file :'Z:\vph1\Code\PE_Error.h'
; file :'Z:\vph1\Code\PE_Const.h'
; file :'Z:\vph1\Code\IO_Map.h'
; file :'Z:\vph1\Code\PE_Types.h'
; file :'Z:\vph1\Code\Serie_Clock.h'
; file :'Z:\vph1\Code\PE_Types.h'
; file :'Z:\vph1\Code\PE_Error.h'
; file :'Z:\vph1\Code\PE_Const.h'
; file :'Z:\vph1\Code\IO_Map.h'
; file :'Z:\vph1\Code\PE_Types.h'
; file :'Z:\vph1\Code\Cpu.h'
; file :'Z:\vph1\Code\Serie_DataOut.h'
; file :'Z:\vph1\Code\PE_Types.h'
; file :'Z:\vph1\Code\PE_Error.h'
; file :'Z:\vph1\Code\PE_Const.h'
; file :'Z:\vph1\Code\IO_Map.h'
; file :'Z:\vph1\Code\PE_Types.h'
; file :'Z:\vph1\Code\Cpu.h'
; file :'Z:\vph1\Code\Serie_DataIn.h'
; file :'Z:\vph1\Code\PE_Types.h'
; file :'Z:\vph1\Code\PE_Error.h'
; file :'Z:\vph1\Code\PE_Const.h'
; file :'Z:\vph1\Code\IO_Map.h'
; file :'Z:\vph1\Code\PE_Types.h'
; file :'Z:\vph1\Code\Cpu.h'
; file :'Z:\vph1\Code\delay.h'
; file :'E:\Documents and settings\oscar\Mis documentos\bin\Metrowerks\CodeWarrior HC08_V2.0\lib\HC08c\INCLUDE\stdlib.h'
; file :'E:\Documents and settings\oscar\Mis documentos\bin\Metrowerks\CodeWarrior HC08_V2.0\lib\HC08c\INCLUDE\stddef.h'
; file :'E:\Documents and settings\oscar\Mis documentos\bin\Metrowerks\CodeWarrior HC08_V2.0\lib\HC08c\INCLUDE\libdefs.h'
; file :'E:\Documents and settings\oscar\Mis documentos\bin\Metrowerks\CodeWarrior HC08_V2.0\lib\HC08c\INCLUDE\hidef.h'
; file :'E:\Documents and settings\oscar\Mis documentos\bin\Metrowerks\CodeWarrior HC08_V2.0\lib\HC08c\INCLUDE\stddef.h'
; file :'E:\Documents and settings\oscar\Mis documentos\bin\Metrowerks\CodeWarrior HC08_V2.0\lib\HC08c\INCLUDE\stdtypes.h'
; file :'E:\Documents and settings\oscar\Mis documentos\bin\Metrowerks\CodeWarrior HC08_V2.0\lib\HC08c\INCLUDE\ctype.h'
;
